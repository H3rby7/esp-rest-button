## main/Kconfig.projbuild
```kconfig
menu "APP Configuration"
  config DMX_WEB_SERVER_HOST
      string "DMX Webserver Hostname"
      default "dmxweb.local"
      help
          DMX Webserver Endpoint host-name.
  config DMX_WEB_SERVER_PORT
      int "DMX Webserver Port"
      default "80"
      help
          DMX Webserver Endpoint port.
endmenu
```

## sdkconfig.defaults
```kconfig
## For Bluedroid as binary is larger than default size
CONFIG_PARTITION_TABLE_CUSTOM=y
CONFIG_PARTITION_TABLE_CUSTOM_FILENAME="partitions.csv"
CONFIG_PARTITION_TABLE_FILENAME="partitions.csv"

# Standard HTTP Header size is too small for modern browser headers
# https://github.com/tonyp7/esp32-wifi-manager/issues/127#issuecomment-906844183
CONFIG_HTTPD_MAX_REQ_HDR_LEN=1024
```
